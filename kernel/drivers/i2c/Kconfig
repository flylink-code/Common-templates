## kernel/drivers/i2c/Kconfig
```kconfig
config DRV_I2C_TEMPLATES
    tristate "i2c templates xxxxxxxxxxxxxx"
    default n
    help
        xxxxxxxxxxxxxxxxxxxxxxxxxxxxxxxx
if CONFIG_DRV_I2C_TEMPLATES
config DRV_I2C_USE_DEBUG
    tristate "i2c templates debug enalbe"
    default n
    select DRV_I2C_USE_DEBUG
endif
```

## kernel/drivers/spi/Kconfig
```kconfig
config DRV_SPI_TEMPLATES
    tristate "spi templates xxxxxxxxxxxxxx"
    default n
    help
        xxxxxxxxxxxxxxxxxxxxxxxxxxxxxxxx
if CONFIG_DRV_SPI_TEMPLATES
config SPI_TODSP_USE_DEBUG
    tristate "spi templates debug enalbe"
    default n
    select SPI_TODSP_USE_DEBUG
endif
```
